// Generated by scripts/embed_web_control.py; edit web/* instead.
#pragma once

static const char CONTROL_INDEX[] PROGMEM = R"SPYCAR(<!doctype html>
<html lang="en">
<head>
  <meta charset="utf-8">
  <meta name="viewport" content="width=device-width,initial-scale=1,viewport-fit=cover">
  <meta name="theme-color" content="#ffffff">
  <meta name="control-token" content="%CONTROL_TOKEN%">
  <title>Spy Car</title>
  <link rel="stylesheet" href="/style.css">
  <script src="/control.js" defer></script>
</head>
<body>
  <main class="controller" aria-label="Car remote control">
    <div class="status-row">
      <span id="connection-dot" class="status-dot" aria-hidden="true"></span>
      <p id="status" role="status" aria-live="polite">Connecting…</p>
      <span id="battery">— V</span>
    </div>
    <div class="controls">
      <div id="joystick" class="joystick" role="group" aria-label="Hold and drag joystick" aria-disabled="true" aria-describedby="drive-hint">
        <div id="knob" class="knob"></div>
      </div>
    </div>
    <div class="sr-only">
      <p id="drive-hint">Hold and drag to drive. Further from the center means faster. Release to stop.</p>
      <span id="drive-state">Stopped</span><span id="speed">0</span>%
    </div>
  </main>
</body>
</html>
)SPYCAR";

static const char CONTROL_JS[] PROGMEM = R"SPYCAR(/* Same-host controller. Every drive command consumes the last server token. */
(() => {
  'use strict';
  const pad = document.getElementById('joystick');
  const knob = document.getElementById('knob');
  const status = document.getElementById('status');
  const dot = document.getElementById('connection-dot');
  const battery = document.getElementById('battery');
  const speed = document.getElementById('speed');
  const driveState = document.getElementById('drive-state');
  const SEND_MS = 50, ACK_MS = 180, RECONNECT_MS = 750;
  let socket = null, reconnectTimer = null, ackTimer = null;
  let token = null, ready = false, held = false, pointer = null;
  let phase = 'stopped', gesture = 0, desired = {x: 0, y: 0};
  let pending = null, lastSent = -Infinity;

  function connected() { return socket && socket.readyState === WebSocket.OPEN; }
  function render() {
    pad.setAttribute('aria-disabled', String(!ready || !connected()));
    pad.classList.toggle('held', held);
    dot.classList.toggle('ready', ready && connected());
    speed.textContent = phase === 'driving' ? String(Math.round(Math.hypot(desired.x, desired.y) / 10)) : '0';
    driveState.textContent = phase === 'arming' ? 'Hold to arm…' : held ? 'Driving' : 'Stopped';
  }
  function clearPending() {
    if (ackTimer !== null) clearTimeout(ackTimer);
    ackTimer = null; pending = null;
  }
  function cancelGesture(sendStop) {
    const oldPointer = pointer;
    pointer = null; held = false; phase = 'stopped'; desired = {x: 0, y: 0};
    ++gesture;
    pad.style.setProperty('--knob-x', '0px');
    pad.style.setProperty('--knob-y', '0px');
    if (oldPointer !== null && pad.hasPointerCapture(oldPointer)) pad.releasePointerCapture(oldPointer);
    // "stop" intentionally bypasses the outstanding-command restriction.
    if (sendStop && connected()) {
      token = null; // Stop invalidates the old token; wait for its fresh reply.
      if (!pending) {
        pending = {gesture, centeredHold: false, sentAt: performance.now()};
        const current = socket;
        ackTimer = setTimeout(() => {
          if (socket === current && pending) disconnect('Response timed out');
        }, ACK_MS + 1);
      }
      try { socket.send('stop'); } catch (_) { disconnect('Connection lost'); }
    }
    render();
  }
  function scheduleReconnect() {
    if (reconnectTimer !== null) return;
    reconnectTimer = setTimeout(() => { reconnectTimer = null; connect(); }, RECONNECT_MS);
  }
  function disconnect(message) {
    const old = socket;
    socket = null; ready = false; token = null;
    clearPending(); cancelGesture(false);
    status.textContent = message + ' · reconnecting…';
    battery.textContent = '— V';
    if (old && old.readyState < WebSocket.CLOSING) old.close();
    scheduleReconnect();
  }
  function pump() {
    if (!connected() || token === null || pending || performance.now() - lastSent < SEND_MS) return;
    const active = held && ready;
    const move = active && phase === 'driving' ? desired : {x: 0, y: 0};
    pending = {gesture, centeredHold: active && phase === 'arming', sentAt: performance.now()};
    const packet = `${token},${active ? 1 : 0},${move.x},${move.y}`;
    token = null; lastSent = performance.now();
    const current = socket;
    ackTimer = setTimeout(() => {
      if (socket === current && pending) disconnect('Response timed out');
    }, ACK_MS + 1);
    try { socket.send(packet); } catch (_) { disconnect('Connection lost'); }
  }
  function connect() {
    cancelGesture(false); clearPending(); ready = false; token = null; lastSent = -Infinity;
    status.textContent = 'Connecting…'; render();
    let current;
    try {
      const bootstrap = document.querySelector('meta[name="control-token"]').content;
      current = new WebSocket(`${location.protocol === 'https:' ? 'wss:' : 'ws:'}//${location.host}/ws?token=${encodeURIComponent(bootstrap)}`);
    } catch (_) { disconnect('Connection unavailable'); return; }
    socket = current;
    current.addEventListener('open', () => {
      if (socket !== current) return;
      status.textContent = 'Checking the car…';
      pending = {gesture, centeredHold: false, sentAt: performance.now()};
      ackTimer = setTimeout(() => {
        if (socket === current && pending) disconnect('Response timed out');
      }, ACK_MS + 1);
      try { current.send('hello'); } catch (_) { disconnect('Connection lost'); }
    });
    current.addEventListener('message', event => {
      if (socket !== current) return;
      // A suspended event loop can deliver a late message before its timer.
      if (pending && performance.now() - pending.sentAt > ACK_MS) {
        disconnect('Response timed out'); return;
      }
      let data;
      try { data = JSON.parse(event.data); } catch (_) { disconnect('Invalid car response'); return; }
      if (!data || !Number.isInteger(data.token) || data.token < 0 || data.token > 0xffffffff ||
          typeof data.ready !== 'boolean' || typeof data.armed !== 'boolean' || typeof data.reset !== 'boolean') {
        disconnect('Invalid car response'); return;
      }
      const acknowledged = pending;
      clearPending(); token = data.token; ready = data.ready;
      if (data.reset) cancelGesture(false); // Never answer a reset with another stop.
      else if (!ready && held) cancelGesture(true);
      else if (held && phase === 'driving' && !data.armed) cancelGesture(false);
      else if (held && phase === 'arming' && acknowledged && acknowledged.centeredHold &&
               acknowledged.gesture === gesture && data.armed) phase = 'driving';
      status.textContent = typeof data.reason === 'string' && data.reason ? data.reason : ready ? 'Ready' : 'Not ready';
      battery.textContent = typeof data.battery === 'number' && Number.isFinite(data.battery) ? `${data.battery.toFixed(2)} V` : '— V';
      render(); pump();
    });
    current.addEventListener('close', () => { if (socket === current) disconnect('Disconnected'); });
    current.addEventListener('error', () => { if (socket === current) disconnect('Connection lost'); });
  }
  function updatePosition(event) {
    const rect = pad.getBoundingClientRect();
    const radius = Math.max(1, Math.min(rect.width, rect.height) / 2 - knob.offsetWidth / 2 - 10);
    let x = (event.clientX - rect.left - rect.width / 2) / radius;
    let y = (rect.top + rect.height / 2 - event.clientY) / radius;
    const length = Math.hypot(x, y);
    if (length > 1) { x /= length; y /= length; }
    let ix = Math.round(x * 1000), iy = Math.round(y * 1000);
    const roundedLength = Math.hypot(ix, iy);
    if (roundedLength > 1000) { ix = Math.trunc(ix * 1000 / roundedLength); iy = Math.trunc(iy * 1000 / roundedLength); }
    desired = {x: ix, y: iy};
    pad.style.setProperty('--knob-x', `${x * radius}px`);
    pad.style.setProperty('--knob-y', `${-y * radius}px`);
    render();
  }
  pad.addEventListener('pointerdown', event => {
    if (!ready || !connected() || held || event.isPrimary === false || (event.pointerType === 'mouse' && event.button !== 0)) return;
    event.preventDefault(); pointer = event.pointerId; held = true; phase = 'arming'; ++gesture;
    pad.setPointerCapture(pointer); updatePosition(event); pump();
  });
  pad.addEventListener('pointermove', event => {
    if (held && event.pointerId === pointer) { event.preventDefault(); updatePosition(event); }
  });
  function release(event) {
    if (held && event.pointerId === pointer) cancelGesture(true);
  }
  pad.addEventListener('pointerup', release);
  pad.addEventListener('pointercancel', release);
  pad.addEventListener('lostpointercapture', release);
  window.addEventListener('blur', () => cancelGesture(true));
  window.addEventListener('pagehide', () => cancelGesture(true));
  document.addEventListener('visibilitychange', () => { if (document.hidden) cancelGesture(true); });
  setInterval(pump, 25);
  connect();
})();
)SPYCAR";

static const char CONTROL_CSS[] PROGMEM = R"SPYCAR(:root {
  color-scheme: light;
  font-family: ui-sans-serif, system-ui, -apple-system, sans-serif;
  color: #202020;
  background: #fff;
  --knob-x: 0px;
  --knob-y: 0px;
}
* { box-sizing: border-box; }
body { margin: 0; overscroll-behavior: none; }
.controller {
  min-height: 100dvh;
  max-width: 400px;
  margin: auto;
  padding: max(28px, env(safe-area-inset-top)) 28px max(28px, env(safe-area-inset-bottom));
  display: flex;
  flex-direction: column;
}
.status-row { display: flex; align-items: center; gap: 10px; min-height: 20px; }
.status-dot { width: 5px; height: 5px; flex-shrink: 0; border-radius: 50%; background: #ccc; }
.status-dot.ready { background: #333; }
#status { font-size: 11px; font-weight: 400; color: #888; margin: 0; }
#battery { margin-left: auto; color: #999; font-size: 11px; font-variant-numeric: tabular-nums; white-space: nowrap; }
.controls { flex: 1; display: flex; flex-direction: column; justify-content: center; align-items: center; padding: 28px 0; }
.joystick {
  position: relative;
  width: min(100%, 280px, 55dvh);
  aspect-ratio: 1;
  border: 1px solid #e6e6e6;
  border-radius: 50%;
  background: #fafafa;
  touch-action: none;
  user-select: none;
  -webkit-user-select: none;
  cursor: grab;
  overflow: hidden;
}
.joystick[aria-disabled=true] { opacity: .35; cursor: not-allowed; }
.joystick.held { cursor: grabbing; }
.knob {
  position: absolute;
  width: 64px;
  height: 64px;
  left: calc(50% - 32px);
  top: calc(50% - 32px);
  border-radius: 50%;
  background: #252525;
  transform: translate(var(--knob-x), var(--knob-y));
  pointer-events: none;
}
.sr-only, .status-row:has(.ready) #status {
  position: absolute;
  width: 1px;
  height: 1px;
  padding: 0;
  margin: -1px;
  overflow: hidden;
  clip-path: inset(50%);
  white-space: nowrap;
  border: 0;
}
)SPYCAR";
